## AirMonitorProject/components/c_ble/Kconfig.projbuild
```kconfig
menu "BLE Configuration"

    config EXAMPLE_DUMP_ADV_DATA_AND_SCAN_RESP
        bool "Dump whole adv data and scan response data in example"
        default n
    config DURATION
        int "Duración del escaneo "
        range 1 30
        default 20
        help
            Duración del escaneo.
    config INTERVAL
        int "Duración del intervalo entre escaneos milesegundos"
        range 1000 10000
        default 5000
        help
            Duración del intervalo entre escaneos milisengundos.

endmenu
```

## AirMonitorProject/components/c_deepSleep/Kconfig.projbuild
```kconfig
menu "DeepSleep Configuration"
    menu "Wake up time"
        config START_HOUR
            int "Wake up hour"
            default 8
            help 
                Ingrese hora en la que comenzara el dispositivo a funcionar
        
        config START_MINUTE
            int "Wake up minute"
            default 0
            help
                Ingrese minuto en la que comenzara el dispositivo a funcionar


    endmenu
    

    menu "Sleep time"
        config FINAL_HOUR
            int "Sleep hour"
            default 22
            help 
                Ingrese hora en la que terminara el dispositivo de funcionar
        
        config FINAL_MINUTE
            int "Sleep minute"
            default 0
            help
                Ingrese minuto en la que terminara el dispositivo de funcionar
    
    endmenu

endmenu
```

## AirMonitorProject/components/c_mqtt/Kconfig.projbuild
```kconfig
menu "Com MQTT Configuration"

    config MQTT_BROKER_URL
        string "Broker URL"
        default "mqtt://test.mosquitto.org"
        help
            URL of the broker to connect to

    # Define a configuration option to enable or disable MQTT LWT
    config MQTT_USE_LWT
        bool "Enable MQTT Last Will and Testament (LWT)"
        default n
        help
            Enable this option if you want to configure MQTT with Last Will and Testament.

    if MQTT_USE_LWT

        # Define a configuration option to set the LWT topic
        config MQTT_LWT_TOPIC
            string "MQTT's Last Will Topic"
            default "graveyard"
            help
                Set Last Will Topic to which publish the node's last will msg

        # Define a configuration option to enable or disable MQTT LWT
        config MQTT_USE_LWT_CUSTOM_MSG
            bool "Use a custom (and const) msg"
            default n
            help
                Enable this option if you want to configure a custom msg for your LWT.
        
            if MQTT_USE_LWT_CUSTOM_MSG
                # Define a configuration option to set the LWT message
                config MQTT_LWT_MESSAGE
                    string "MQTT LWT Message"
                    default "A node is down"
                    help
                        Set the MQTT LWT message.
            
            endif  # MQTT_USE_LWT_CUSTOM_MSG

        config MQTT_LWT_KEEPALIVE
            string "MQTT's LWT keepalive timeout"
            default 10
            help
                Max seconds until broker realizes node is down

    endif  # MQTT_USE_LWT

    
endmenu
```

## AirMonitorProject/components/c_provisioning/Kconfig.projbuild
```kconfig
menu "Example Configuration"

    config EXAMPLE_RESET_PROVISIONED
        bool
        default n
        prompt "Reset provisioned status of the device"
        help
            This erases the NVS to reset provisioned status of the device on every reboot.
            Provisioned status is determined by the Wi-Fi STA configuration, saved on the NVS.

    config EXAMPLE_RESET_PROV_MGR_ON_FAILURE
        bool
        default y
        prompt "Reset provisioned credentials and state machine after session failure"
        help
            Enable reseting provisioned credentials and state machine after session failure.
            This will restart the provisioning service after retries are exhausted.

    config EXAMPLE_PROV_MGR_MAX_RETRY_CNT
        int
        default 5
        prompt "Max retries before reseting provisioning state machine"
        depends on EXAMPLE_RESET_PROV_MGR_ON_FAILURE
        help
            Set the Maximum retry to avoid reconnecting to an inexistent AP or if credentials
            are misconfigured. Provisioned credentials are erased and internal state machine
            is reset after this threshold is reached.

    config EXAMPLE_PROV_SHOW_QR
        bool "Show provisioning QR code"
        default y
        help
            Show the QR code for provisioning.

    config EXAMPLE_PROV_USING_BLUEDROID
        bool
        depends on (BT_BLUEDROID_ENABLED && (IDF_TARGET_ESP32C3 || IDF_TARGET_ESP32S3))
        select BT_BLE_42_FEATURES_SUPPORTED
        default y
        help
            This enables BLE 4.2 features for Bluedroid.

    config EXAMPLE_REPROVISIONING
        bool "Re-provisioning"
        help
            Enable re-provisioning - allow the device to provision for new credentials
            after previous successful provisioning.

endmenu
```

## AirMonitorProject/components/c_sensorSGP30/Kconfig.projbuild
```kconfig
menu "SGP30 I2C Peripheral Configuration"

    menu "I2C Master"
        config I2C_MASTER_SCL
            int "SCL GPIO Num"
            default 22
            help
                GPIO number for I2C Master clock line.

        config I2C_MASTER_SDA
            int "SDA GPIO Num"
            default 21
            help
                GPIO number for I2C Master data line.

        config I2C_MASTER_PORT_NUM
            int "Port Number"
            default 1
            help
                Port number for I2C Master device.

        config I2C_MASTER_FREQUENCY
            int "Master Frequency"
            default 100000
            help
                I2C Speed of Master device.
    endmenu

    menu "Sensor"

        config SEND_SENSOR_FREQ_TVOC
            int "Sensor send rate in seconds for TVOC"
            range 1 100
            default 10
            help
                Rate at which a sensor collects data in seconds.

        config SEND_SENSOR_FREQ_ECO2
            int "Sensor send rate in seconds for ECO2"
            range 1 100
            default 10
            help
                Rate at which a sensor collects data in seconds.

        config SAMPLING_SENSOR_FREQ
            int "Sensor sampling rate in seconds"
            range 1 100
            default 2
            help
                Rate at which a sensor collects data in seconds.
        
    endmenu

endmenu
```

## AirMonitorProject/components/c_spiffs/Kconfig.projbuild
```kconfig
menu "Com SPIFFS Menu"

    config SPIFFS_CHECK_ON_START
        bool "Run SPIFFS_check on every start-up"
        default y
        help
            If this config item is set, esp_spiffs_check() will be run on every start-up.
            Slow on large flash sizes.

    config SPIFFS_LOG_FILE
        string "Filename of the file that will store LOG entries"
        default "log.txt"

    config SPIFFS_DIRECTORY
        string "SPIFFS Directory"
        default "/spiffs"
        help
            Start with /
    

endmenu
```

## AirMonitorProject/main/Kconfig.projbuild
```kconfig
menu "Com MQTT - Thingsboard Configuration"

    menu "Provisioning"

        config TB_PROVISION_USERNAME
            string "Thingsboard provision Username"
            default "provision"

        config TB_PROVISION_DEVICE_KEY
            string "Thingsboard device profile's provision key"
            default "2lkpfzzf7bpy74iwzn66"
            help
                Look at Device profiles -> select device -> Device provisioning

        config TB_PROVISION_DEVICE_SECRET
            string "Thingsboard device profile's provision secret"
            default "03mt3l6srz9bijscmr9n"
            help
                Look at Device profiles -> select device -> Device provisioning
            
        config TB_PROVISION_REQUEST_TOPIC
            string "Thingsboard provision request Topic"
            default "/provision/request"
            help
                Topic to publish your provisioning request
    
        config TB_PROVISION_RESPONSE_TOPIC
            string "Thingsboard provision response Topic"
            default "/provision/response"
            help
                Topic to subscribe to in order to receive the provision request's answer
    
    endmenu

    menu "Communication"
        config TB_TELEMETRY_TOPIC
            string "Thingsboard Telemetry Topic"
            default "v1/devices/me/telemetry"
            help
                Topic to publish/subscribe to in order to send telemetry to TB

        menu "Server Side RPC"
    
            config TB_SS_RPC_RESPONSE_TOPIC
                string "Thingsboard Server Side Response Topic"
                default "v1/devices/me/rpc/response/"
                help
                    Topic to publish/subscribe to in order to answer petitions from TB. End it with /

            config TB_SS_RPC_REQUEST_TOPIC
                string "Thingsboard Server Side Request Topic"
                default "v1/devices/me/rpc/request/+"

        endmenu

        menu "Client Side RPC"
            config TB_CS_RPC_REQUEST_TOPIC
                string "Thingsboard Client Side Request Topic"
                default "v1/devices/me/rpc/request/"
    
            config TB_CS_RPC_RESPONSE_TOPIC
                string "Thingsboard Client Side Response Topic"
                default "v1/devices/me/rpc/response/+"
                
        endmenu

    endmenu

endmenu



menu "Com NVS Configuration"

    config NVS_KEY_TB_TOKEN
        string "Key associated with the access token provisioned by thingsboard"
        default "tb_prov_token"

    config NVS_KEY_TB_CTX
        string "Key associated with the node's context"
        default "tb_node_ctx"

endmenu




menu "Com OTA Configuration"

    config OTA_FIRMWARE_UPGRADE_URL
        string "firmware upgrade url endpoint"
        default "https://192.168.0.3:8070/hello_world.bin"
        help
            URL of server which hosts the firmware
            image.

    config OTA_USE_CERT_BUNDLE
        bool "Enable certificate bundle"
        default y
        depends on MBEDTLS_CERTIFICATE_BUNDLE
        help
            Enable trusted root certificate bundle. This approach allows to have
            OTA updates functional with any public server without requirement
            to explicitly add its server certificate.

    config OTA_FIRMWARE_UPGRADE_URL_FROM_STDIN
        bool
        default y if OTA_FIRMWARE_UPGRADE_URL = "FROM_STDIN"

    config OTA_SKIP_COMMON_NAME_CHECK
        bool "Skip server certificate CN fieldcheck"
        default n
        help
            This allows you to skip the validation of OTA server certificate CN field.

    config OTA_FIRMWARE_UPGRADE_BIND_IF
        bool "Support firmware upgrade bind specified interface"
        default n
        help
            This allows you to bind specified interface in OTA example.

    choice OTA_FIRMWARE_UPGRADE_BIND_IF_TYPE
        prompt "Choose OTA data bind interface"
        default OTA_FIRMWARE_UPGRADE_BIND_IF_STA
        depends on OTA_FIRMWARE_UPGRADE_BIND_IF
        help
            Select which interface type of OTA data go through.

        config OTA_FIRMWARE_UPGRADE_BIND_IF_STA
            bool "Bind wifi station interface"
            depends on OTA_CONNECT_WIFI
            help
                Select wifi station interface to pass the OTA data.

        config OTA_FIRMWARE_UPGRADE_BIND_IF_ETH
            bool "Bind ethernet interface"
            depends on OTA_CONNECT_ETHERNET
            help
                Select ethernet interface to pass the OTA data.
    endchoice
endmenu
```

## AirMonitorProjectCoAP/components/c_coap/Kconfig.projbuild
```kconfig
menu "Com COAP Configuration"

    config COAP_HOST_NAME
        string "Host name"
        default "localhost"
        help
            hostname of the server

endmenu
```

## AirMonitorProjectCoAP/components/c_sensorSI7021/Kconfig.projbuild
```kconfig
menu "SI7021 I2C Peripheral Configuration"

    menu "I2C Master"
        config I2C_MASTER_SCL
            int "SCL GPIO Num"
            default 27
            help
                GPIO number for I2C Master clock line.

        config I2C_MASTER_SDA
            int "SDA GPIO Num"
            default 26
            help
                GPIO number for I2C Master data line.

        config I2C_MASTER_PORT_NUM
            int "Port Number"
            default 0
            help
                Port number for I2C Master device.

        config I2C_MASTER_FREQUENCY
            int "Master Frequency"
            default 400000
            help
                I2C Speed of Master device.
    endmenu

    menu "Sensor"

        config SAMPLING_SENSOR_FREQ_TEMP
            int "Temperature sensor sampling rate in seconds"
            range 1 100
            default 2
            help
                Rate at which a sensor collects data in seconds.

        config SAMPLING_SENSOR_FREQ_HUM
            int "Humidity sensor sampling rate in seconds"
            range 1 100
            default 2
            help
                Rate at which a sensor collects data in seconds.

        config SEND_SENSOR_FREQ_TEMP
            int "Temperature sensor send rate in seconds"
            range 1 100
            default 10
            help
                Rate at which a sensor collects data in seconds.

        config SEND_SENSOR_FREQ_HUM
            int "Humidity sensor send rate in seconds"
            range 1 100
            default 10
            help
                Rate at which a sensor collects data in seconds.
        
    endmenu

endmenu
```
